## drivers/net/wireless/rtl8192cu_custom/Kconfig
```kconfig
config RTL8192CU_CUSTOM
	tristate "Realtek 8192C USB WiFi using custom driver"
	depends on USB
	---help---
	  Help message of RTL8192CU
```
